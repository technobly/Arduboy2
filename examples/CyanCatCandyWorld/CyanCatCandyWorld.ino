/***********************************************
    Cyan Cat Candy World
    by Brett Walach
    Version 0.9.6
    July 2018

    Changes:

      Moon changed to Particle logo
      Unicorn replaced with Cyan Cat
      Ghosts changed into the dreaded Toaster!
      Added sound! (melody into, melody, game over)
      Added star power jump ability, lets you soar over the enemies! (press LEFT or RIGHT while in the air)
      Clouds slowly roll up and down
      Star field slowly moving in distance
      High score leading 0's removed for readability
      High score saved as soon as Game Over screen appears
      Cyan Cat RGB LED heartbeat while running!
      High volume (press UP), Low volume (press DOWN)

    Remixed from these sources:

    Base game from:

      Unicorn Dash
      By Kirill Korolkov
      Version 0.9.5
      February, 2018

    Music from:

      ArduNyan
      Wade McGillis
      https://github.com/wademcgillis/ardunyan

      ArduNyan2
      KeyboardCamper
      https://github.com/KeyboardCamper/ArduNyan

  Sprite Editor:

    SSASE - Arduboy sprite editor (initially)
    https://community.arduboy.com/t/ssase-arduboy-sprite-editor/2532

    ToChars
    http://www.crait.net/tochars/index.php

*************************************************/

#include <Arduboy2.h>
// #include <ArduboyTones.h>
// #include "melody.h"
#include "Tinyfont.h"

#define GROUND_HEIGHT       46
#define OBSTACLE_DELAY_MAX  512
#define OBSTACLE_DELAY_MIN  96
#define BONUS_DELAY_MAX     1024
#define BONUS_DELAY_MIN     512

enum State {
    Intro,
    Play,
    Pause,
    Over,
    Credits
};

struct Position {
    int x;
    int y;
};
struct Velocity {
    int x;
    int y;
};
struct Size {
    unsigned int width;
    unsigned int height;
};

struct Object {
    Position pos;
    Velocity vel;
    Rect     box;
    unsigned int frame;
    unsigned int type;
    boolean action;
};
struct Star {
    Position pos;
    unsigned int frame;
};
struct Particles {
    Position pos;
    unsigned int life;
    unsigned int lifeCount;
};

const byte spriteLogoA[] PROGMEM = {
0x00, 0x00, 0x00, 0x00, 0x00, 0x00, 0x00, 0x00, 0x00, 0x00, 0x00, 0x00,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 0x00,
0x00, 0x00, 0x00, 0x00, 0x00, 0x00, 0x00, 0x00, 0x00, 0x00, 0x00, 0x00,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 0x00,
0x00, 0x00, 0x00, 0x00, 0x00, 0x00, 0x00, 0x00, 0x00, 0x00, 0x00, 0x00,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 0x00,
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0x00, 0x00, 0x00, 0x00, 0x00, 0x00, 0x00, 0x00, 0x00, 0x00, 0x00, 0x00,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 0x00,
};

const byte spritePaused[] PROGMEM = {
0x00, 0x00, 0x00, 0x00, 0x00, 0x00, 0x00, 0x00, 0x00, 0x00, 0x00, 0x00,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 0x00,
0x00, 0x00, 0x00, 0x00, 0x00, 0x00, 0x00, 0x00, 0x00, 0x00, 0x00, 0x00,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 0x00,
0x00, 0x00, 0x00, 0x00, 0x00, 0x00, 0x00, 0x00, 0x00, 0x00, 0x00, 0x00,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 0x00,
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0x00, 0x00, 0x00, 0x00, 0x00, 0x00, 0x00, 0x00, 0x00, 0x00, 0x00, 0x00,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 0x00,
};

const byte spriteBackgroundA[] PROGMEM  = {
    0xc0, 0xf0, 0xf8, 0xfc, 0xfc, 0xfe, 0xfe, 0xfe, 0xfe, 0xfc, 0xfc, 0xf8,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 0xf,
};
const byte spriteBackgroundB[] PROGMEM  = {
    0x00, 0x00, 0x00, 0x00, 0x00, 0x00, 0x00, 0x00, 0x00, 0x00, 0x00, 0x00,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 0x54,
};

// PARTICLE LOGO
const byte spriteMoon[] PROGMEM = {
    0x80,0x80,0xC4,0x98,0x38,0xF0,0xE4,0xEF,0xE4,0xF0,0x38,0x98,0xC4,0x80,0x80,0x00,0x00,0x00,0x11,0x0C,0x0E,0x07,0x13,0x7B,0x13,0x07,0x0E,0x0C,0x11,0x00,0x00,0x00,
};

const byte spriteStar_0[] PROGMEM  = { 0x00, 0x00, 0x00, 0x00, 0x8, 0x00, 0x00, 0x00 };
const byte spriteStar_1[] PROGMEM  = { 0x00, 0x00, 0x00, 0x8, 0x1c, 0x8, 0x00, 0x00 };
const byte spriteStar_2[] PROGMEM  = { 0x00, 0x00, 0x00, 0x8, 0x14, 0x8, 0x00, 0x00 };
const byte spriteStar_3[] PROGMEM  = { 0x00, 0x00, 0x8, 0x8, 0x36, 0x8, 0x8, 0x00 };
const byte spriteStar_4[] PROGMEM  = { 0x00, 0x00, 0x8, 0x00, 0x2a, 0x00, 0x8, 0x00 };
const byte *animationFramesStar[] = { spriteStar_0, spriteStar_1, spriteStar_2, spriteStar_3, spriteStar_4 };

const byte spriteNyanCat_0[] PROGMEM  = {
    0x00,0x00,0xE0,0x10,0x50,0x10,0x90,0x50,0x90,0x10,0x50,0x10,0x20,0x80,0x40,0x80,
    0xC3,0xE6,0x1F,0xE1,0xE8,0x20,0x0F,0xD0,0xE8,0x2D,0xE1,0xE1,0x29,0x2C,0x10,0x0F,
};
const byte spriteNyanCat_1[] PROGMEM  = {
    0x00,0x00,0xE0,0x10,0x50,0x90,0x50,0x90,0x10,0x10,0x50,0x10,0xA0,0x40,0x80,0x00,
    0x66,0x76,0x1F,0x61,0x68,0x2F,0x10,0x68,0x6D,0x21,0x61,0x69,0x2C,0x10,0x0F,0x00,
};
const byte spriteNyanCat_2[] PROGMEM  = {
    0x00,0x00,0xE0,0x10,0x50,0x90,0x50,0x90,0x10,0x10,0x50,0x10,0xA0,0x40,0x80,0x00,
    0x0C,0x66,0x7F,0x21,0x68,0x6F,0x10,0x28,0x6D,0x61,0x21,0x69,0x6C,0x10,0x0F,0x00,
};
const byte spriteNyanCat_3[] PROGMEM  = {
    0x00,0x00,0xE0,0x10,0x50,0x10,0x90,0x50,0x90,0x10,0x50,0x10,0x20,0x80,0x40,0x80,
    0x06,0xC6,0xFF,0x21,0xE8,0xE0,0x0F,0x10,0xE8,0xED,0x21,0xE1,0xE9,0x2C,0x10,0x0F,
};
const byte spriteNyanCat_4[] PROGMEM  = {
    0x00,0x00,0xE0,0x10,0x50,0x10,0x90,0x50,0x90,0x10,0x50,0x10,0x20,0x80,0x40,0x80,
    0x00,0x00,0x1F,0x21,0x28,0x20,0x0F,0x10,0x28,0x2D,0x21,0x21,0x29,0x2C,0x10,0x0F,
};

const byte spriteNyanCatMask_0[] PROGMEM  = {
    0x00,0x00,0x00,0xE0,0xA0,0xE0,0x60,0xA0,0x60,0xE0,0xA0,0xE0,0xC0,0x40,0x80,0x00,
    0x00,0x00,0x00,0x1E,0x17,0x1F,0x10,0x0F,0x17,0x12,0x1E,0x1E,0x16,0x13,0x0F,0x00,
};
const byte spriteNyanCatMask_1[] PROGMEM  = {
    0x00,0x00,0x00,0xE0,0xA0,0x60,0xA0,0x60,0xE0,0xE0,0xA0,0xE0,0x40,0x80,0x00,0x00,
    0x00,0x00,0x00,0x1E,0x17,0x10,0x0F,0x17,0x12,0x1E,0x1E,0x16,0x13,0x0F,0x00,0x00,
};
const byte spriteNyanCatMask_2[] PROGMEM  = {
    0x00,0x00,0x00,0xE0,0xA0,0x60,0xA0,0x60,0xE0,0xE0,0xA0,0xE0,0x40,0x80,0x00,0x00,
    0x00,0x00,0x00,0x1E,0x17,0x10,0x0F,0x17,0x12,0x1E,0x1E,0x16,0x13,0x0F,0x00,0x00,
};
const byte spriteNyanCatMask_3[] PROGMEM  = {
    0x00,0x00,0x00,0xE0,0xA0,0xE0,0x60,0xA0,0x60,0xE0,0xA0,0xE0,0xC0,0x40,0x80,0x00,
    0x00,0x00,0x00,0x1E,0x17,0x1F,0x10,0x0F,0x17,0x12,0x1E,0x1E,0x16,0x13,0x0F,0x00,
};
const byte spriteNyanCatMask_4[] PROGMEM  = {
    0x00,0x00,0x00,0xE0,0xA0,0xE0,0x60,0xA0,0x60,0xE0,0xA0,0xE0,0xC0,0x40,0x80,0x00,
    0x00,0x00,0x00,0x1E,0x17,0x1F,0x10,0x0F,0x17,0x12,0x1E,0x1E,0x16,0x13,0x0F,0x00,
};

const byte *animationFramesNyanCat[] = { spriteNyanCat_0, spriteNyanCat_1, spriteNyanCat_2, spriteNyanCat_3, spriteNyanCat_4 };
const byte *animationFramesNyanCatMask[] = { spriteNyanCatMask_0, spriteNyanCatMask_1, spriteNyanCatMask_2, spriteNyanCatMask_3, spriteNyanCatMask_4 };

const byte spriteStar[] PROGMEM  = {
    0x00, 0x00, 0x00, 0x00, 0x00, 0x00, 0x00, 0x00, 0x00, 0x00, 0x00, 0x00, 0x00, 0x00, 0x00, 0x00, 0x00, 0x00, 0x00, 0x00, 0x4, 0x6c, 0x7c, 0x3f, 0x37, 0x7c, 0x6c, 0x4, 0x00, 0x00, 0x00, 0x00,
};
const byte spriteStarMask[] PROGMEM  = {
    0x00, 0x00, 0x00, 0x00, 0x00, 0x00, 0x00, 0x80, 0x80, 0x00, 0x00, 0x00, 0x00, 0x00, 0x00, 0x00, 0x00, 0x00, 0x00, 0x4, 0x6a, 0x92, 0x83, 0x40, 0x48, 0x83, 0x92, 0x6a, 0x4, 0x00, 0x00, 0x00,
};
//Toaster
const byte spriteGhost[] PROGMEM  = {
    0xFC,0x06,0x4A,0x12,0x22,0x49,0x91,0x25,0x89,0x92,0x44,0x48,0x28,0x30,0xE0,0x00,0x0F,0x10,0x26,0x48,0x49,0x80,0x80,0xFF,0x80,0x80,0x44,0x42,0x20,0x20,0x1F,0x00,
};
const byte spriteGhostMask[] PROGMEM  = {
    0x00,0xF8,0xB4,0xEC,0xDC,0xB6,0x6E,0xDA,0x76,0x6C,0xB8,0xB0,0xD0,0xC0,0x00,0x00,0x00,0x0F,0x19,0x37,0x36,0x7F,0x7F,0x00,0x7F,0x7F,0x3B,0x3D,0x1F,0x1F,0x00,0x00,
};
const byte *spritesObject[] = { spriteGhost, spriteStar };
const byte *spritesObjectMask[] = { spriteGhostMask, spriteStarMask };

// Sound
const uint16_t melody_intro[] PROGMEM = {
 NOTE_DS6,107, NOTE_E6,107, NOTE_FS6,214, NOTE_B6,214, NOTE_DS6,107, NOTE_E6,107,
 NOTE_FS6,107, NOTE_B6,107, NOTE_CS7,107, NOTE_DS7,107, NOTE_CS7,107, NOTE_AS6,107, NOTE_B6,214, NOTE_FS6,214,
 NOTE_DS6,107, NOTE_E6,107, NOTE_FS6,214, NOTE_B6,107, NOTE_CS7,214, NOTE_AS6,107, NOTE_B6,107, NOTE_CS7,107,
 NOTE_E7,107, NOTE_DS7,107, NOTE_E7,107, NOTE_CS7,107,
 TONES_END
};
const uint16_t melody[] PROGMEM = {
 NOTE_FS6,214, NOTE_GS6,107, NOTE_REST,107, NOTE_CS6,107, NOTE_DS6,214, NOTE_B5,53, NOTE_REST,53, NOTE_D6,107,
 NOTE_CS6,107, NOTE_B5,107, NOTE_REST,107, NOTE_B5,107, NOTE_REST,107, NOTE_CS6,214, NOTE_D6,107, NOTE_REST,107,
 NOTE_D6,53, NOTE_REST,53, NOTE_CS6,53, NOTE_REST,53, NOTE_B5,107, NOTE_CS6,107, NOTE_DS6,107, NOTE_FS6,107,
 NOTE_GS6,107, NOTE_DS6,107, NOTE_FS6,107, NOTE_CS6,107, NOTE_D6,107, NOTE_B5,107, NOTE_CS6,107, NOTE_B5,107,
 NOTE_DS6,214, NOTE_FS6,107, NOTE_REST,107, NOTE_GS6,107, NOTE_DS6,107, NOTE_FS6,107, NOTE_CS6,107, NOTE_D6,107,
 NOTE_B5,107, NOTE_CS6,107, NOTE_DS6,107, NOTE_D6,107, NOTE_CS6,107, NOTE_B5,107, NOTE_CS6,107, NOTE_D6,107,
 NOTE_REST,107, NOTE_B5,107, NOTE_CS6,107, NOTE_D6,107, NOTE_FS6,107, NOTE_CS6,107, NOTE_D6,107, NOTE_CS6,107,
 NOTE_B5,107, NOTE_CS6,107, NOTE_REST,107, NOTE_B5,107, NOTE_REST,107, NOTE_CS6,107, NOTE_REST,107, NOTE_FS6,214,
 NOTE_GS6,107, NOTE_REST,107, NOTE_CS6,107, NOTE_DS6,214, NOTE_B5,53, NOTE_REST,53, NOTE_D6,107, NOTE_CS6,107,
 NOTE_B5,107, NOTE_REST,107, NOTE_B5,107, NOTE_REST,107, NOTE_CS6,214, NOTE_D6,107, NOTE_REST,107, NOTE_D6,53,
 NOTE_REST,53, NOTE_CS6,53, NOTE_REST,53, NOTE_B5,107, NOTE_CS6,107, NOTE_DS6,107, NOTE_FS6,107, NOTE_GS6,107,
 NOTE_DS6,107, NOTE_FS6,107, NOTE_CS6,107, NOTE_D6,107, NOTE_B5,107, NOTE_CS6,107, NOTE_B5,107, NOTE_DS6,214,
 NOTE_FS6,107, NOTE_REST,107, NOTE_GS6,107, NOTE_DS6,107, NOTE_FS6,107, NOTE_CS6,107, NOTE_D6,107, NOTE_B5,107,
 NOTE_CS6,107, NOTE_DS6,107, NOTE_D6,107, NOTE_CS6,107, NOTE_B5,107, NOTE_CS6,107, NOTE_D6,107, NOTE_REST,107,
 NOTE_B5,107, NOTE_CS6,107, NOTE_D6,107, NOTE_FS6,107, NOTE_CS6,107, NOTE_D6,107, NOTE_CS6,107, NOTE_B5,107,
 NOTE_CS6,214, NOTE_B5,107, NOTE_REST,107, NOTE_B5,107, NOTE_REST,107, NOTE_B5,107, NOTE_REST,107, NOTE_FS5,107,
 NOTE_GS5,107, NOTE_B5,107, NOTE_REST,107, NOTE_FS5,107, NOTE_GS5,107, NOTE_B5,107, NOTE_CS6,107, NOTE_DS6,107,
 NOTE_CS6,107, NOTE_E6,107, NOTE_DS6,107, NOTE_E6,107, NOTE_FS6,107, NOTE_B5,107, NOTE_REST,107, NOTE_B5,107,
 NOTE_REST,107, NOTE_FS5,107, NOTE_GS5,107, NOTE_B5,107, NOTE_GS5,107, NOTE_E6,107, NOTE_DS6,107, NOTE_CS6,107,
 NOTE_B5,107, NOTE_FS5,107, NOTE_DS5,107, NOTE_E5,107, NOTE_FS5,107, NOTE_B5,107, NOTE_REST,107, NOTE_FS5,107,
 NOTE_GS5,107, NOTE_B5,107, NOTE_REST,107, NOTE_FS5,107, NOTE_GS5,107, NOTE_B5,107, NOTE_B5,107, NOTE_CS6,107,
 NOTE_DS6,107, NOTE_B5,107, NOTE_FS5,107, NOTE_GS5,107, NOTE_FS5,107, NOTE_B5,214, NOTE_B5,107, NOTE_AS5,107,
 NOTE_B5,107, NOTE_FS5,107, NOTE_GS5,107, NOTE_B5,107, NOTE_E6,107, NOTE_DS6,107, NOTE_E6,107, NOTE_FS6,107,
 NOTE_B5,107, NOTE_REST,107, NOTE_AS5,107, NOTE_REST,107, NOTE_B5,107, NOTE_REST,107, NOTE_FS5,107, NOTE_GS5,107,
 NOTE_B5,107, NOTE_REST,107, NOTE_FS5,107, NOTE_GS5,107, NOTE_B5,107, NOTE_CS6,107, NOTE_DS6,107, NOTE_CS6,107,
 NOTE_E6,107, NOTE_DS6,107, NOTE_E6,107, NOTE_FS6,107, NOTE_B5,107, NOTE_REST,107, NOTE_B5,107, NOTE_REST,107,
 NOTE_FS5,107, NOTE_GS5,107, NOTE_B5,107, NOTE_GS5,107, NOTE_E6,107, NOTE_DS6,107, NOTE_CS6,107, NOTE_B5,107,
 NOTE_FS5,107, NOTE_DS5,107, NOTE_E5,107, NOTE_FS5,107, NOTE_B5,107, NOTE_REST,107, NOTE_FS5,107, NOTE_GS5,107,
 NOTE_B5,107, NOTE_REST,107, NOTE_FS5,107, NOTE_GS5,107, NOTE_B5,107, NOTE_B5,107, NOTE_CS6,107, NOTE_DS6,107,
 NOTE_B5,107, NOTE_FS5,107, NOTE_GS5,107, NOTE_FS5,107, NOTE_B5,214, NOTE_B5,107, NOTE_AS5,107, NOTE_B5,107,
 NOTE_FS5,107, NOTE_GS5,107, NOTE_B5,107, NOTE_E6,107, NOTE_DS6,107, NOTE_E6,107, NOTE_FS6,107, NOTE_B5,214, NOTE_CS6,214,
 TONES_REPEAT,

 NOTE_FS6,214, NOTE_GS6,107, NOTE_REST,107, NOTE_CS6,107, NOTE_DS6,214, NOTE_B5,53, NOTE_REST,53,
 NOTE_D6,107, NOTE_CS6,107, NOTE_B5,107, NOTE_REST,107, NOTE_B5,107, NOTE_REST,107, NOTE_CS6,214, NOTE_D6,107,
 NOTE_REST,107, NOTE_D6,53, NOTE_REST,53, NOTE_CS6,53, NOTE_REST,53, NOTE_B5,107, NOTE_CS6,107, NOTE_DS6,107,
 NOTE_FS6,107, NOTE_GS6,107, NOTE_DS6,107, NOTE_FS6,107, NOTE_CS6,107, NOTE_D6,107, NOTE_B5,107, NOTE_CS6,107,
 NOTE_B5,107, NOTE_DS6,214, NOTE_FS6,107, NOTE_REST,107, NOTE_GS6,107, NOTE_DS6,107, NOTE_FS6,107, NOTE_CS6,107,
 NOTE_D6,107, NOTE_B5,107, NOTE_CS6,107, NOTE_DS6,107, NOTE_D6,107, NOTE_CS6,107, NOTE_B5,107, NOTE_CS6,107,
 NOTE_D6,107, NOTE_REST,107, NOTE_B5,107, NOTE_CS6,107, NOTE_D6,107, NOTE_FS6,107, NOTE_CS6,107, NOTE_D6,107,
 NOTE_CS6,107, NOTE_B5,107, NOTE_CS6,107, NOTE_REST,107, NOTE_B5,107, NOTE_REST,107, NOTE_CS6,107, NOTE_REST,107,
 NOTE_FS6,214, NOTE_GS6,107, NOTE_REST,107, NOTE_CS6,107, NOTE_DS6,214, NOTE_B5,53, NOTE_REST,53, NOTE_D6,107,
 NOTE_CS6,107, NOTE_B5,107, NOTE_REST,107, NOTE_B5,107, NOTE_REST,107, NOTE_CS6,214, NOTE_D6,107, NOTE_REST,107,
 NOTE_D6,53, NOTE_REST,53, NOTE_CS6,53, NOTE_REST,53, NOTE_B5,107, NOTE_CS6,107, NOTE_DS6,107, NOTE_FS6,107,
 NOTE_GS6,107, NOTE_DS6,107, NOTE_FS6,107, NOTE_CS6,107, NOTE_D6,107, NOTE_B5,107, NOTE_CS6,107, NOTE_B5,107,
 NOTE_DS6,214, NOTE_FS6,107, NOTE_REST,107, NOTE_GS6,107, NOTE_DS6,107, NOTE_FS6,107, NOTE_CS6,107, NOTE_D6,107,
 NOTE_B5,107, NOTE_CS6,107, NOTE_DS6,107, NOTE_D6,107, NOTE_CS6,107, NOTE_B5,107, NOTE_CS6,107, NOTE_D6,107,
 NOTE_REST,107, NOTE_B5,107, NOTE_CS6,107, NOTE_D6,107, NOTE_FS6,107, NOTE_CS6,107, NOTE_D6,107, NOTE_CS6,107,
 NOTE_B5,107, NOTE_CS6,214, NOTE_B5,107, NOTE_REST,107, NOTE_B5,107, NOTE_REST,107, NOTE_B5,107, NOTE_REST,107,
 NOTE_FS5,107, NOTE_GS5,107, NOTE_B5,107, NOTE_REST,107, NOTE_FS5,107, NOTE_GS5,107, NOTE_B5,107, NOTE_CS6,107,
 NOTE_DS6,107, NOTE_CS6,107, NOTE_E6,107, NOTE_DS6,107, NOTE_E6,107, NOTE_FS6,107, NOTE_B5,107, NOTE_REST,107,
 NOTE_B5,107, NOTE_REST,107, NOTE_FS5,107, NOTE_GS5,107, NOTE_B5,107, NOTE_GS5,107, NOTE_E6,107, NOTE_DS6,107,
 NOTE_CS6,107, NOTE_B5,107, NOTE_FS5,107, NOTE_DS5,107, NOTE_E5,107, NOTE_FS5,107, NOTE_B5,107, NOTE_REST,107,
 NOTE_FS5,107, NOTE_GS5,107, NOTE_B5,107, NOTE_REST,107, NOTE_FS5,107, NOTE_GS5,107, NOTE_B5,107, NOTE_B5,107,
 NOTE_CS6,107, NOTE_DS6,107, NOTE_B5,107, NOTE_FS5,107, NOTE_GS5,107, NOTE_FS5,107, NOTE_B5,214, NOTE_B5,107,
 NOTE_AS5,107, NOTE_B5,107, NOTE_FS5,107, NOTE_GS5,107, NOTE_B5,107, NOTE_E6,107, NOTE_DS6,107, NOTE_E6,107,
 NOTE_FS6,107, NOTE_B5,107, NOTE_REST,107, NOTE_AS5,107, NOTE_REST,107, NOTE_B5,107, NOTE_REST,107, NOTE_FS5,107,
 NOTE_GS5,107, NOTE_B5,107, NOTE_REST,107, NOTE_FS5,107, NOTE_GS5,107, NOTE_B5,107, NOTE_CS6,107, NOTE_DS6,107,
 NOTE_CS6,107, NOTE_E6,107, NOTE_DS6,107, NOTE_E6,107, NOTE_FS6,107, NOTE_B5,107, NOTE_REST,107, NOTE_B5,107,
 NOTE_REST,107, NOTE_FS5,107, NOTE_GS5,107, NOTE_B5,107, NOTE_GS5,107, NOTE_E6,107, NOTE_DS6,107, NOTE_CS6,107,
 NOTE_B5,107, NOTE_FS5,107, NOTE_DS5,107, NOTE_E5,107, NOTE_FS5,107, NOTE_B5,107, NOTE_REST,107, NOTE_FS5,107,
 NOTE_GS5,107, NOTE_B5,107, NOTE_REST,107, NOTE_FS5,107, NOTE_GS5,107, NOTE_B5,107, NOTE_B5,107, NOTE_CS6,107,
 NOTE_DS6,107, NOTE_B5,107, NOTE_FS5,107, NOTE_GS5,107, NOTE_FS5,107, NOTE_B5,214, NOTE_B5,107, NOTE_AS5,107,
 NOTE_B5,107, NOTE_FS5,107, NOTE_GS5,107, NOTE_B5,107, NOTE_E6,107, NOTE_DS6,107, NOTE_E6,107, NOTE_FS6,107,
 NOTE_B5,214, NOTE_CS6,214,

 NOTE_E4,214, NOTE_E5,214, NOTE_FS4,214, NOTE_FS5,214, NOTE_DS4,214, NOTE_DS5,214,
 NOTE_GS4,214, NOTE_GS5,214, NOTE_CS4,214, NOTE_CS5,214, NOTE_FS4,214, NOTE_FS5,214, NOTE_B3,214, NOTE_B4,214,
 NOTE_B3,214, NOTE_B4,214, NOTE_E4,214, NOTE_E5,214, NOTE_FS4,214, NOTE_FS5,214, NOTE_DS4,214, NOTE_DS5,214,
 NOTE_GS4,214, NOTE_GS5,214, NOTE_CS4,214, NOTE_CS5,214, NOTE_FS4,214, NOTE_FS5,214, NOTE_B3,214, NOTE_B4,214,
 NOTE_B3,214, NOTE_B4,214, NOTE_E4,214, NOTE_E5,214, NOTE_FS4,214, NOTE_FS5,214, NOTE_DS4,214, NOTE_DS5,214,
 NOTE_GS4,214, NOTE_GS5,214, NOTE_CS4,214, NOTE_CS5,214, NOTE_FS4,214, NOTE_FS5,214, NOTE_B3,214, NOTE_B4,214,
 NOTE_B3,214, NOTE_B4,214, NOTE_E4,214, NOTE_E5,214, NOTE_FS4,214, NOTE_FS5,214, NOTE_DS4,214, NOTE_DS5,214,
 NOTE_GS4,214, NOTE_GS5,214, NOTE_CS4,214, NOTE_CS5,214, NOTE_FS4,214, NOTE_FS5,214, NOTE_B3,214, NOTE_B4,214,
 NOTE_B3,214, NOTE_B4,214, NOTE_E4,214, NOTE_GS4,214, NOTE_B4,214, NOTE_E5,214, NOTE_DS4,214, NOTE_FS4,214,
 NOTE_B4,214, NOTE_DS5,214, NOTE_CS4,214, NOTE_E4,214, NOTE_GS4,214, NOTE_B4,214, NOTE_B3,214, NOTE_DS4,214,
 NOTE_FS4,214, NOTE_B4,214, NOTE_E4,214, NOTE_GS4,214, NOTE_B4,214, NOTE_E5,214, NOTE_DS4,214, NOTE_FS4,214,
 NOTE_B4,214, NOTE_DS5,214, NOTE_CS4,214, NOTE_E4,214, NOTE_GS4,214, NOTE_B4,214, NOTE_B3,214, NOTE_DS4,214,
 NOTE_FS4,214, NOTE_B4,214, NOTE_E4,214, NOTE_GS4,214, NOTE_B4,214, NOTE_E5,214, NOTE_DS4,214, NOTE_FS4,214,
 NOTE_B4,214, NOTE_DS5,214, NOTE_CS4,214, NOTE_E4,214, NOTE_GS4,214, NOTE_B4,214, NOTE_B3,214, NOTE_DS4,214,
 NOTE_FS4,214, NOTE_B4,214, NOTE_E4,214, NOTE_GS4,214, NOTE_B4,214, NOTE_E5,214, NOTE_DS4,214, NOTE_FS4,214,
 NOTE_B4,214, NOTE_DS5,214, NOTE_CS4,214, NOTE_E4,214, NOTE_GS4,214, NOTE_B4,214, NOTE_B3,214, NOTE_DS4,214,
 NOTE_FS4,214, NOTE_B4,214, NOTE_E4,214, NOTE_E5,214, NOTE_FS4,214, NOTE_FS5,214, NOTE_DS4,214, NOTE_DS5,214,
 NOTE_GS4,214, NOTE_GS5,214, NOTE_CS4,214, NOTE_CS5,214, NOTE_FS4,214, NOTE_FS5,214, NOTE_B3,214, NOTE_B4,214,
 NOTE_B3,214, NOTE_B4,214, NOTE_E4,214, NOTE_E5,214, NOTE_FS4,214, NOTE_FS5,214, NOTE_DS4,214, NOTE_DS5,214,
 NOTE_GS4,214, NOTE_GS5,214, NOTE_CS4,214, NOTE_CS5,214, NOTE_FS4,214, NOTE_FS5,214, NOTE_B3,214, NOTE_B4,214,
 NOTE_B3,214, NOTE_B4,214, NOTE_E4,214, NOTE_E5,214, NOTE_FS4,214, NOTE_FS5,214, NOTE_DS4,214, NOTE_DS5,214,
 NOTE_GS4,214, NOTE_GS5,214, NOTE_CS4,214, NOTE_CS5,214, NOTE_FS4,214, NOTE_FS5,214, NOTE_B3,214, NOTE_B4,214,
 NOTE_B3,214, NOTE_B4,214, NOTE_E4,214, NOTE_E5,214, NOTE_FS4,214, NOTE_FS5,214, NOTE_DS4,214, NOTE_DS5,214,
 NOTE_GS4,214, NOTE_GS5,214, NOTE_CS4,214, NOTE_CS5,214, NOTE_FS4,214, NOTE_FS5,214, NOTE_B3,214, NOTE_B4,214,
 NOTE_B3,214, NOTE_B4,214, NOTE_E4,214, NOTE_GS4,214, NOTE_B4,214, NOTE_E5,214, NOTE_DS4,214, NOTE_FS4,214,
 NOTE_B4,214, NOTE_DS5,214, NOTE_CS4,214, NOTE_E4,214, NOTE_GS4,214, NOTE_B4,214, NOTE_B3,214, NOTE_DS4,214,
 NOTE_FS4,214, NOTE_B4,214, NOTE_E4,214, NOTE_GS4,214, NOTE_B4,214, NOTE_E5,214, NOTE_DS4,214, NOTE_FS4,214,
 NOTE_B4,214, NOTE_DS5,214, NOTE_CS4,214, NOTE_E4,214, NOTE_GS4,214, NOTE_B4,214, NOTE_B3,214, NOTE_DS4,214,
 NOTE_FS4,214, NOTE_B4,214, NOTE_E4,214, NOTE_GS4,214, NOTE_B4,214, NOTE_E5,214, NOTE_DS4,214, NOTE_FS4,214,
 NOTE_B4,214, NOTE_DS5,214, NOTE_CS4,214, NOTE_E4,214, NOTE_GS4,214, NOTE_B4,214, NOTE_B3,214, NOTE_DS4,214,
 NOTE_FS4,214, NOTE_B4,214, NOTE_E4,214, NOTE_GS4,214, NOTE_B4,214, NOTE_E5,214, NOTE_DS4,214, NOTE_FS4,214,
 NOTE_B4,214, NOTE_DS5,214, NOTE_CS4,214, NOTE_E4,214, NOTE_GS4,214, NOTE_B4,214, NOTE_B3,214, NOTE_DS4,214,
 NOTE_FS4,214, NOTE_B4,214,

 TONES_REPEAT
};
#define MULT 1.75 // 2.5 is the correct tempo, but lets speed it up for speeding up sake
const uint16_t game_over[] PROGMEM = {
 // GLITCH
 NOTE_A2,10, NOTE_B2,10, NOTE_REST,10,
 NOTE_A2,10, NOTE_B2,10, NOTE_REST,10,
 NOTE_A2,10, NOTE_B2,10, NOTE_REST,10,
 NOTE_A2,10, NOTE_B2,10, NOTE_REST,10,
 NOTE_A2,10, NOTE_B2,10, NOTE_REST,10,
 NOTE_A2,10, NOTE_B2,10, NOTE_REST,10,
 NOTE_A2,10, NOTE_B2,10, NOTE_REST,10,
 NOTE_A2,10, NOTE_B2,10, NOTE_REST,10,
 NOTE_A2,10, NOTE_B2,10, NOTE_REST,10,
 // REST
 NOTE_REST,200,
 // SAD TUNE
// NOTE_A5,100, NOTE_B5,100, NOTE_C6,600, NOTE_D6,200, NOTE_C6,200, NOTE_B5,600, NOTE_C6,200, NOTE_B5,100, NOTE_REST,100, NOTE_B5,200, NOTE_C6,100, NOTE_B5,100, NOTE_A5,600,
// NOTE_A5,200, NOTE_B5,200, NOTE_C6,1200, NOTE_D6,400, NOTE_C6,400, NOTE_B5,1200, NOTE_C6,400, NOTE_B5,200, NOTE_REST,200, NOTE_B5,400, NOTE_C6,200, NOTE_B5,200, NOTE_A5,1200,
// NOTE_A5,100*MULT, NOTE_B5,100*MULT, NOTE_C6,600*MULT, NOTE_D6,200*MULT, NOTE_C6,200*MULT, NOTE_B5,600*MULT, NOTE_C6,200*MULT, NOTE_B5,100*MULT, NOTE_REST,100*MULT, NOTE_B5,200*MULT, NOTE_C6,100*MULT, NOTE_B5,100*MULT, NOTE_A5,600*MULT,

 // NOTE_A5,100, NOTE_B5,100, NOTE_C6,500, NOTE_D6,200, NOTE_C6,100, NOTE_B5,400, NOTE_C6,200, NOTE_B5,50, NOTE_REST,50, NOTE_B5,200, NOTE_C6,50, NOTE_B5,50, NOTE_A5,600,
 // NOTE_A5,200, NOTE_B5,200, NOTE_C6,1000, NOTE_D6,400, NOTE_C6,200, NOTE_B5,800, NOTE_C6,400, NOTE_B5,100, NOTE_REST,100, NOTE_B5,400, NOTE_C6,100, NOTE_B5,100, NOTE_A5,1200,
 NOTE_A5,100*MULT, NOTE_B5,100*MULT, NOTE_C6,500*MULT, NOTE_D6,200*MULT, NOTE_C6,100*MULT, NOTE_B5,400*MULT, NOTE_C6,200*MULT, NOTE_B5,50*MULT, NOTE_REST,50*MULT, NOTE_B5,200*MULT, NOTE_C6,50*MULT, NOTE_B5,50*MULT, NOTE_A5,600*MULT,
 TONES_END
};

boolean btnPressed, dpadPressed;

unsigned int counterState, counterBackgroundA = 0, counterBackgroundB = 0;
int scoreBonusDuration = 0;

long score, scoreHI = 0;

Arduboy2 arduboy;
// ArduboyTones sound(arduboy.audio.enabled);
Tinyfont arduboyTinyFont = Tinyfont(arduboy.sBuffer, Arduboy2::width(), Arduboy2::height());

State state = Intro;

Object unicorn, objects[3];
Particles particles[24];
Star stars[9] = {
    { { 0,  10  }, 1 },
    { { 23,  3  }, 4 },
    { { 27,  24 }, 2 },
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    { { 116, 17 }, 0 }
};

// - PROTOTYPES -----------------------------------------------------------------------
void objectRender(Object object);
Object objectReset(Object object);

// ------------------------------------------------------------------------------------
void setup() {
    Serial.begin(115200);
    arduboy.begin();
    // arduboy.audio.on();

    particlesReset();
    statePlayReset();

    scoreHI = EEPROM.read(EEPROM_STORAGE_SPACE_START);

    // sound.volumeMode(VOLUME_ALWAYS_NORMAL);
//    sound.volumeMode(VOLUME_ALWAYS_HIGH);
}
void loop() {
    if (!arduboy.nextFrame()) {
        return;
    }

    // if (arduboy.everyXFrames(32)) {
    //     randomSeed(analogRead(0)); // reset random
    // }

    arduboy.clear();
    stateUpdate();
    arduboy.display();
}

// ------------------------------------------------------------------------------------
void stateUpdate() {
    counterState = ((counterState + 1) > UINT_MAX) ? 0 : counterState;

    switch (state) {
        case State::Credits:
            stateCreditsUpdate();
            break;

        case State::Play:
            statePlayUpdate();
            break;

        case State::Pause:
            statePauseUpdate();
            break;

        case State::Over:
            stateOverUpdate();
            break;

        default:
            stateIntroUpdate();
            break;
    }
}
void stateSwitch(State stateNew) {
    counterState = 0;
    counterBackgroundA = 0, counterBackgroundB = 0;

    switch (stateNew) {
        case State::Intro:
            statePlayReset();
            break;
    }

    state = stateNew;
};

// STATE INTRO: -----------------------------------------------------------------------
void stateIntroUpdate() {
    counterState += 1;

//    arduboy.drawBitmap(39, 0, spriteLogoA, 50, 58, WHITE);
    arduboy.drawBitmap(0, 0, spriteLogoA, 128, 64, WHITE);
//    arduboy.drawBitmap(4, 16, spriteLogoB, 36, 11, WHITE);

    arduboyTinyFont.setCursor(44, 60);
    for (byte i = (8 - intLength(scoreHI)); i > 0; i--) {
        arduboyTinyFont.print("0");
    }

    arduboyTinyFont.print(scoreHI);

    if ((arduboy.pressed(A_BUTTON) || arduboy.pressed(B_BUTTON)) && !btnPressed) {
        if (arduboy.pressed(B_BUTTON)) {
            stateSwitch(State::Play);
            // sound.tones(melody_intro);
        }
        else if (arduboy.pressed(A_BUTTON)) {
            stateSwitch(State::Credits);
        }
    }
    btnPressed = (arduboy.pressed(A_BUTTON) || arduboy.pressed(B_BUTTON));

    // ZzZ: DEMO
    // if (counterState >= 300) {
    //     stateSwitch(State::Play);
    // }
}

// STATE CREDITS: ---------------------------------------------------------------------=
void stateCreditsUpdate() {
    if (arduboy.everyXFrames(3) && counterState <= 100) {
        // if (arduboy.everyXFrames(3) && counterState <= 300) {
        counterState += 1;
    }

    arduboy.setCursor(43, arduboy.height() - counterState);
    arduboy.print("CREDITS");
    arduboy.setCursor(37, arduboy.height() * 2 - counterState);
    arduboy.print("a game by");
    arduboy.setCursor(19,  arduboy.height() * 2 + 10 - counterState);
    arduboy.print("Brett Walach");

    // arduboy.setCursor(19, arduboy.height() * 2 - counterState);
    // arduboy.print("project manager");
    // arduboy.setCursor(4,  arduboy.height() * 2 + 10 - counterState);
    // arduboy.print("MARISKA VAN DER PEET");
    // arduboy.setCursor(37, arduboy.height() * 3 - counterState);
    // arduboy.print("team lead");
    // arduboy.setCursor(13, arduboy.height() * 3 + 10 - counterState);
    // arduboy.print("MARTIJN STELLINGA");
    // arduboy.setCursor(37, arduboy.height() * 4  - counterState);
    // arduboy.print("developer");
    // arduboy.setCursor(19, arduboy.height() * 4 + 10 - counterState);
    // arduboy.print("KIRILL KOROLKOV");
    // arduboy.setCursor(27, arduboy.height() * 5 - counterState);
    // arduboy.print("in memory of");
    // arduboy.setCursor(19, arduboy.height() * 5 + 10 - counterState);
    // arduboy.print("THOMAS DE BRUIN");
    // arduboy.setCursor(37, arduboy.height() * 5 + 20 - counterState);
    // arduboy.print("2014-2017");

    if (arduboy.pressed(B_BUTTON) && !btnPressed) {
        stateSwitch(State::Intro);
    }
    btnPressed = arduboy.pressed(B_BUTTON);
}

// STATE Over: ---------------------------------------------------------------------
void stateOverUpdate() {
    arduboy.setCursor(37, 18);
    arduboy.print("GAME OVER");
    cyanFade(false);

    for (byte i = 0; i < 3; i++) {
        if (objects[i].type == 0) {
            objectRender(objects[i]);
        }
    }

    unicornRender();
    scoreRender();

    // Save our high score without user input.
    // This way you can switch off the game after game over and it's saved already
    if (score > scoreHI) {
        scoreHI = score;
        EEPROM.update(EEPROM_STORAGE_SPACE_START, scoreHI);
    }

    if (arduboy.pressed(A_BUTTON) && !btnPressed) {
         stateSwitch(State::Intro);
    }
    btnPressed = arduboy.pressed(A_BUTTON);
}

// STATE PLAY: ------------------------------------------------------------------------
void statePlayUpdate() {
    counterState += 1;

    if ((arduboy.pressed(LEFT_BUTTON) || arduboy.pressed(RIGHT_BUTTON))) {
        if (arduboy.pressed(LEFT_BUTTON) && unicorn.action) {
            unicorn.pos.x -= 1;
        }
        if (arduboy.pressed(RIGHT_BUTTON) && unicorn.action) {
            unicorn.pos.x += 1;
        }
    }


    if (arduboy.pressed(UP_BUTTON)) {
        // sound.volumeMode(VOLUME_ALWAYS_HIGH);
    } else if (arduboy.pressed(DOWN_BUTTON)) {
        // sound.volumeMode(VOLUME_ALWAYS_NORMAL);
    }

    if ((arduboy.pressed(A_BUTTON) || arduboy.pressed(B_BUTTON)) && !btnPressed) {
        if (arduboy.pressed(A_BUTTON)) {
            stateSwitch(State::Pause);
        }
        if (arduboy.pressed(B_BUTTON) && unicorn.action) {
            unicorn.vel.y = -3;
            counterState = 0;
        }
    }
    btnPressed = (arduboy.pressed(A_BUTTON) || arduboy.pressed(B_BUTTON));

    backgroundLayerOneRender();
    backgroundLayerTwoRender();
    backgroundLayerThreeRender();

    objectsUpdate();
    unicornUpdate();

    scoreUpdate();

    cyanFade(true);

    // After the melody_intro stops, continue on with the main melody
    // if (!sound.playing()) {
        // sound.tones(melody);
    // }
}
void statePlayReset() {
    score = 0;
    scoreBonusDuration = 0;

    unicornSetup();
    objectsSetup();
}

// STATE PAUSE: -----------------------------------------------------------------------
void statePauseUpdate() {
    arduboy.setCursor(49, (arduboy.height() / 2) - 4);
//    arduboy.print("PAUSE");
    arduboy.drawBitmap(0, 0, spritePaused, 128, 64, WHITE);
    // sound.noTone();
    cyanFade(false);

    scoreRender();

    if ((arduboy.pressed(A_BUTTON) || arduboy.pressed(DOWN_BUTTON)) && !btnPressed) {
        if (arduboy.pressed(DOWN_BUTTON)) {
            stateSwitch(State::Intro);
        }
        else if (arduboy.pressed(A_BUTTON)) {
            stateSwitch(State::Play);
            // sound.tones(melody);
        }
    }
    btnPressed = (arduboy.pressed(A_BUTTON) || arduboy.pressed(DOWN_BUTTON));
}

// UNICORN ----------------------------------------------------------------------------
void unicornSetup() {
    unicorn = { { 48, GROUND_HEIGHT }, { 0, 0 }, { 0, 0, 7, 8 }, 0, 7, true };
}
 void unicornUpdate() {
    // ZzZ: DEMO
    // for (byte i = 0; i < 3; i++) {
    //     int dx = objects[i].pos.x - unicorn.pos.x;
    //
    //     if (dx > 0 && dx <= 24) {
    //         if (unicorn.action) {
    //             unicorn.vel.y = -3;
    //             counterState = 0;
    //         }
    //     }
    // }

    // Long jump boost when capturing star power!!
    if (scoreBonusDuration > 0) {
        if (arduboy.pressed(RIGHT_BUTTON) && !unicorn.action) {
            if (counterState%2 == 0) {
                unicorn.pos.x += 1;
            }
        } else if (arduboy.pressed(LEFT_BUTTON) && !unicorn.action) {
            if (counterState%2 == 0) {
                unicorn.pos.x -= 1;
            }
        }
    }

    if (counterState%10 == 0) {
        unicorn.vel.y += 1;
    }

    unicorn.pos.y = min(unicorn.pos.y + unicorn.vel.y, GROUND_HEIGHT);
    unicorn.pos.x = min(unicorn.pos.x + unicorn.vel.x, arduboy.width() - 12);
    unicorn.pos.x = max(unicorn.pos.x + unicorn.vel.x, -4);

// DEBUG
//    char temp[128];
//    sprintf(temp, "x:%d y:%d x:%d y:%d", unicorn.pos.x, unicorn.pos.y, unicorn.vel.x, unicorn.vel.y);
//    arduboy.print(temp);

    unicorn.box.x = unicorn.pos.x + 4;
    unicorn.box.y = unicorn.pos.y - 9;

    if (unicorn.pos.y >= GROUND_HEIGHT) {
        unicorn.action = true;
        unicorn.vel.y = 0;
    }
    else {
        unicorn.action = false;
    }

    unicornRender();
    particlesRender();
}
void unicornRender() {
    if (unicorn.action) {
        if (arduboy.everyXFrames(6)) {
//            unicorn.frame = ((unicorn.frame + 1) > 2) ? 0 : unicorn.frame + 1;
              unicorn.frame = ((unicorn.frame + 1) > 3) ? 0 : unicorn.frame + 1;
        }
    }
    else {
        unicorn.frame = 4;
    }

//    arduboy.drawBitmap(unicorn.pos.x, unicorn.pos.y - 15, animationFramesUnicornMask[unicorn.frame], 16, 16, BLACK);
//    arduboy.drawBitmap(unicorn.pos.x, unicorn.pos.y - 15, animationFramesUnicorn[unicorn.frame], 16, 16, WHITE);
    arduboy.drawBitmap(unicorn.pos.x, unicorn.pos.y - 15, animationFramesNyanCat[unicorn.frame], 16, 16, BLACK);
    arduboy.drawBitmap(unicorn.pos.x, unicorn.pos.y - 15, animationFramesNyanCatMask[unicorn.frame], 16, 16, WHITE);
}

// OBJECTS ---------------------------------------------------------------------------
void objectsSetup() {
    objects[0] = { { -16, GROUND_HEIGHT }, { -1, 0 }, { 0, 0, 8, 8 }, 0, 0, true };
    objects[1] = { { -16, GROUND_HEIGHT }, { -1, 0 }, { 0, 0, 8, 8 }, 0, 0, true };
    objects[2] = { { -16, 22 },            { -1, 0 }, { 0, 0, 8, 8 }, 0, 1, true };

    for (byte i = 0; i < 3; i++) {
        objects[i] = objectReset(objects[i]);
    }
}
void objectsUpdate() {
    for (byte i = 0; i < 3; i++) {
        objects[i].pos.x += objects[i].vel.x;
        objects[i].box.x = objects[i].pos.x + 4;
        objects[i].box.y = objects[i].pos.y - 8;

        if (objects[i].pos.x >= -8) {
            Rect boxA = { unicorn.box.x, unicorn.box.y, unicorn.box.width, unicorn.box.height };
            Rect boxB = { objects[i].box.x, objects[i].box.y, objects[i].box.width, objects[i].box.height };

            if (arduboy.collide(boxA, boxB)) {
                if (objects[i].type == 0) {
                    state = State::Over;
                    // sound.noTone();
                    // sound.tones(game_over);
                }
                else if (objects[i].type == 1){
                    objects[i] = objectReset(objects[i]);

                    if (scoreBonusDuration <= 0) {
                        particlesReset();
                    }
                    scoreBonusDuration += 50;
                }
            }

            objectRender(objects[i]);
        }
        else {
            objects[i] = objectReset(objects[i]);
        }
    }
}
void objectRender(Object object) {
    arduboy.drawBitmap(object.pos.x, object.pos.y - 15, spritesObjectMask[object.type], 16, 16, BLACK);
    arduboy.drawBitmap(object.pos.x, object.pos.y - 15, spritesObject[object.type], 16, 16, WHITE);
    // arduboy.drawRect(object.box.x, object.box.y, object.box.width, object.box.height, 1); // Collision Box Debug
}
Object objectReset(Object object){
    if (object.type == 0) {
        object.pos.x = arduboy.width() + random(OBSTACLE_DELAY_MIN, OBSTACLE_DELAY_MAX);

        for (byte i = 0; i < 3; i++) {
            if (objects[i].type == 0) {
                if (objects[i].pos.x >= arduboy.width()) {
                    if ((rand()%4) > 2) {
                        object.pos.x = objects[i].pos.x + 10;
                        object.pos.y = GROUND_HEIGHT;
                    }
                    else {
                        object.pos.x = objects[i].pos.x + random(OBSTACLE_DELAY_MIN, OBSTACLE_DELAY_MAX);
                        object.pos.y = GROUND_HEIGHT - random(0, 12);
                    }
                }
            }
        }
    }
    if (object.type == 1) {
        object.pos.x = arduboy.width() + random(BONUS_DELAY_MIN, BONUS_DELAY_MAX);
    }

    return object;
}

// BACKGROUND -------------------------------------------------------------------------
void backgroundLayerOneRender() {
    static int counterStarField = 0;

    if (arduboy.everyXFrames(20)) {
        counterStarField = ((counterStarField + 1) >= 128+16) ? 0 : counterStarField + 1;
    }

    const int logo_offset_x = 11;
    const int logo_offset_y = 10;
    int x_pos_logo = ((logo_offset_x-counterStarField) < -16) ? logo_offset_x-counterStarField+128+16 : logo_offset_x-counterStarField;
    arduboy.drawBitmap(x_pos_logo, logo_offset_y, spriteMoon, 16, 16, WHITE);

    for (byte i = 0; i < 9; i++) {
        if (arduboy.everyXFrames(8)) {
            stars[i].frame = ((stars[i].frame + 1) > 4) ? 0 : stars[i].frame + 1;
        }

        int x_pos_stars = ((stars[i].pos.x - counterStarField) < -16) ? stars[i].pos.x - counterStarField + 128+16 : stars[i].pos.x - counterStarField;
        arduboy.drawBitmap(x_pos_stars, stars[i].pos.y, animationFramesStar[stars[i].frame], 8, 8, WHITE);
    }
}
void backgroundLayerTwoRender() {
    static int bgHeight = 30;
    static int bgDir = 0;
    if (arduboy.everyXFrames(2)) {
        counterBackgroundA = ((counterBackgroundA + 1) >= 24) ? 0 : counterBackgroundA + 1;
    }
    if (arduboy.everyXFrames(16)) {
        if (bgDir == 1) {
            if (bgHeight > 28) bgHeight--;
            else bgDir = 0;
        } else {
            if (bgHeight < 32) bgHeight++;
            else bgDir = 1;
        }
    }
    for (byte i = 0; i <= 6; i++) {
//        arduboy.drawBitmap(((i * 24) - counterBackgroundA), 28, spriteBackgroundA, 24, 36, WHITE);
          arduboy.drawBitmap(((i * 24) - counterBackgroundA), bgHeight, spriteBackgroundA, 24, 36, WHITE);
    }
}
void backgroundLayerThreeRender() {
    if (arduboy.everyXFrames(1)) {
        counterBackgroundB = ((counterBackgroundB + 1) >= 24) ? 0 : counterBackgroundB + 1;
    }

    for (byte i = 0; i <= 6; i++) {
        arduboy.drawBitmap(((i * 24) - counterBackgroundB), 41, spriteBackgroundB, 24, 24, BLACK);
    }
}

// SCORE -----------------------------------------------------------------------------
void scoreUpdate() {
    if (arduboy.everyXFrames(16)) {
        scoreBonusDuration = max(0, (scoreBonusDuration - 1));

        if (scoreBonusDuration > 0){
            score += 10;
        }

        score = min(99999999, (score + 1));
    }

    scoreRender();
}
void scoreRender() {
    if (score > scoreHI) {
        arduboyTinyFont.setCursor(77, 4);
        arduboyTinyFont.print("HI");
    }
    else {
        arduboyTinyFont.setCursor(87, 4);
    }

    for (byte i = (8 - intLength(score)); i > 0; i--) {
        arduboyTinyFont.print(" ");
    }

    arduboyTinyFont.print(score);
}

// HELPERS ----------------------------------------------------------------------------
int intLength(int i) {
    int j = 0;

    for(; i; i /= 10) j++;

    return (j == 0) ? 1 : j;
}

void particlesRender() {
    if (scoreBonusDuration <= 0) {
        return;
    }

    for (byte i = 0; i < 24; i++) {
        particles[i].pos.x -= 1;

        if (particles[i].lifeCount > particles[i].life) {
            particles[i].life = 8 + rand()%32;
            particles[i].lifeCount = 0;

            particles[i].pos.y = unicorn.pos.y - 3 + ((rand()%2 > 0) ? (rand()%4 * -1) : rand()%4);
            particles[i].pos.x = unicorn.pos.x + 4;
        }
        else {
            particles[i].lifeCount += 1;
        }

        arduboy.drawPixel(particles[i].pos.x, particles[i].pos.y - 1, 0);
        arduboy.drawPixel(particles[i].pos.x, particles[i].pos.y, 1);
    }
}
void particlesReset() {
    for (int i = 0; i < 24; ++i) {
        particles[i] = { { 0, 0 }, 0 };
    }
};
void cyanFade(bool fade) {
    static uint16_t color = 0;
    static uint32_t now = 0;
    static uint32_t lastFade = 0;
    static int dir = 1;
    if (fade) {
        now = millis();
        if (now - lastFade > 10) {
            lastFade = now;
            if (dir == 1) {
                color++;
                if (color >= 40) dir = 0;
            }
            else {
                color--;
                if (color == 0) dir = 1;
            }
            arduboy.setRGBled(0,color,color);
        }
    } else {
        arduboy.setRGBled(0,0,0);
    }
}
